...
amba_pl
{
	compatible = "simple-bus";
	ranges;
	#adress-cells = <0x1>;
	#size-cells = <0x1>;

	gpio@41200000 {
		compatible = "led_gpio";
		xlnx,gpio2-width = <0x20>;
		xlnx,interrupt-present = <0x0>;
		xlnx,all-inputs = <0x0>;
		xlnx,dout-default = <0x0>;
		gpio-controller;
		xlnx,tri-default-2 = <0xffffffff>;
		xlnx,all-outputs = <0x1>;
		xlnx,all-inputs-2 = <0x0>;
		xlnx,dout-default-2 = <0x0>;
		xlnx,is-dual = <0x0>;
		xlnx,all-outputs-2 = <0x0>;
		xlnx,tri-default = <0xffffffff>;
		reg = <0x41200000 0x10000>;
		#gpio-cells = <0x2>;
		xlnx,gpio-width = <0x4>;
	};
}
...
